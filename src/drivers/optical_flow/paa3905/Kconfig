## src/drivers/optical_flow/paa3905/Kconfig
```kconfig
menuconfig DRIVERS_OPTICAL_FLOW_PAA3905
	bool "paa3905"
	default n
	---help---
		Enable support for PixArt paa3905

config PAA3905_RAW_DEBUG
	bool "Capture raw PAA3905 flow and synchronized gyro"
	default n
	depends on (DRIVERS_OPTICAL_FLOW_PAA3905 && SENSORS_VEHICLE_OPTICAL_FLOW) || DRIVERS_UAVCAN
	---help---
		Publish every burst before rejection, integrate raw gyro over its window,
		and transport/log diagnostic data. Adds traffic to DroneCAN and ULog.
```

## src/modules/obstacle_map/Kconfig
```kconfig
menuconfig MODULES_OBSTACLE_MAP
	bool "obstacle_map"
	default n
	---help---
		Persistent 3D obstacle map built from range images. Publishes obstacle_distance for Collision Prevention.

config OBSTACLE_MAP_SIZE_XY
	int "Voxels along north and along east, a power of two"
	default 64
	depends on MODULES_OBSTACLE_MAP
	---help---
		The map holds SIZE_XY x SIZE_XY x SIZE_Z voxels at half a byte each, 64 KB at the defaults.

config OBSTACLE_MAP_SIZE_Z
	int "Voxels along down, a power of two"
	default 32
	depends on MODULES_OBSTACLE_MAP
```
