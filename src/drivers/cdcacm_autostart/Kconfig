## src/drivers/cdcacm_autostart/Kconfig
```kconfig
menuconfig DRIVERS_CDCACM_AUTOSTART
	bool "cdcacm_autostart"
	default n
	---help---
		Enable support for cdcacm_autostart
```

## src/drivers/watts/Kconfig
```kconfig
menu "watts"
    menuconfig WATTS_DRIVERS
        bool "Watts Drivers"
        default n
        select BQ76952
        ---help---
            Enable watts driver
    rsource "*/Kconfig"
endmenu #watts
```

## src/drivers/watts/bms/Kconfig
```kconfig
menuconfig DRIVERS_WATTS_BMS
	bool "bms"
	default n
	---help---
		Enable support for bms
```

## src/drivers/watts/bq34z100/Kconfig
```kconfig
menuconfig DRIVERS_WATTS_BQ34Z100
	bool "bq34z100"
	default n
	---help---
		Enable support for bq34z100
```

## src/drivers/watts/bq76952/Kconfig
```kconfig
menuconfig DRIVERS_WATTS_BQ76952
	bool "bq76952"
	default n
	---help---
		Enable support for bq76952
```

## src/drivers/watts/ssd1306/Kconfig
```kconfig
menuconfig DRIVERS_WATTS_SSD1306
	bool "ssd1306"
	default n
	---help---
		Enable support for ssd1306
```

## src/drivers/watts/ssd1306_display/Kconfig
```kconfig
menuconfig DRIVERS_WATTS_SSD1306_DISPLAY
	bool "ssd1306_display"
	default n
	---help---
		Enable support for ssd1306
```

## src/drivers/watts/watts_bms/Kconfig
```kconfig
menuconfig DRIVERS_WATTS_WATTS_BMS
	bool "watts_bms"
	default n
	---help---
		Enable support for watts_bms
```

## src/modules/accel_fft/Kconfig
```kconfig
menuconfig MODULES_ACCEL_FFT
	bool "accel_fft"
	default n
	---help---
		Enable support for accel_fft

menuconfig USER_ACCEL_FFT
	bool "accel_fft running as userspace module"
	default n
	depends on BOARD_PROTECTED && MODULES_ACCEL_FFT
	---help---
		Put accel_fft in userspace memory
```

## src/modules/simulation/mujoco_simulator/Kconfig
```kconfig
menuconfig MODULES_SIMULATION_MUJOCO_SIMULATOR
    bool "MuJoCo Simulator"
    default n
    depends on PLATFORM_POSIX
    ---help---
        MuJoCo simulator module.
```
